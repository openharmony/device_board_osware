## imx8mm/ethernet/adapter/Kconfig
```kconfig
config DRIVERS_HDF_IMX8MM_ETHERNET
    bool "Enable ethernet"
    default n
    depends on DRIVERS_HDF_PLATFORM
    help
      Answer Y to enable NXP ethernet chip driver.
```
